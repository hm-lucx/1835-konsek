## backend/src/eg1835/data/board.yml
```yaml
# 1835 Konsek Board Layout — reconstructed from the printed map.
# Flat-top hexes: q = column (left→right), r = band (odd q offset down).
# terrain: plain | town | city | home | citybrown | mountain | water | offboard
board:
  width: 22
  height: 8
  positions:
    - q: 7
      r: 0
      tile_id: 0
      terrain: "water"
    - q: 8
      r: 0
      tile_id: 0
      terrain: "water"
    - q: 9
      r: 0
      tile_id: 0
      terrain: "water"
    - q: 10
      r: 0
      tile_id: 0
      terrain: "water"
    - q: 11
      r: 0
      tile_id: 0
      terrain: "citywhite"
      name: "Kiel"
    - q: 12
      r: 0
      tile_id: 0
      terrain: "water"
    - q: 13
      r: 0
      tile_id: 0
      terrain: "water"
    - q: 14
      r: 0
      tile_id: 0
      terrain: "water"
    - q: 21
      r: 0
      tile_id: 0
      terrain: "offboard"
      value: "20/20/40"
    - q: 3
      r: 1
      tile_id: 0
      terrain: "water"
    - q: 4
      r: 1
      tile_id: 0
      terrain: "plain"
    - q: 5
      r: 1
      tile_id: 0
      terrain: "home"
      name: "Oldenburg"
      marker: "O"
    - q: 6
      r: 1
      tile_id: 0
      terrain: "plain"
    - q: 7
      r: 1
      tile_id: 0
      terrain: "city"
      name: "Bremen"
      value: "50"
    - q: 8
      r: 1
      tile_id: 0
      terrain: "plain"
    - q: 9
      r: 1
      tile_id: 0
      terrain: "plain"
    - q: 10
      r: 1
      tile_id: 0
      terrain: "city"
      name: "Hamburg"
      value: "50"
      marker: "H"
    - q: 11
      r: 1
      tile_id: 0
      terrain: "plain"
    - q: 12
      r: 1
      tile_id: 0
      terrain: "home"
      name: "Schwerin"
      marker: "M"
    - q: 13
      r: 1
      tile_id: 0
      terrain: "plain"
    - q: 14
      r: 1
      tile_id: 0
      terrain: "plain"
    - q: 15
      r: 1
      tile_id: 0
      terrain: "plain"
    - q: 16
      r: 1
      tile_id: 0
      terrain: "plain"
    - q: 17
      r: 1
      tile_id: 0
      terrain: "plain"
    - q: 18
      r: 1
      tile_id: 0
      terrain: "plain"
    - q: 19
      r: 1
      tile_id: 0
      terrain: "plain"
    - q: 20
      r: 1
      tile_id: 0
      terrain: "water"
    - q: 3
      r: 2
      tile_id: 0
      terrain: "plain"
    - q: 4
      r: 2
      tile_id: 0
      terrain: "plain"
    - q: 5
      r: 2
      tile_id: 0
      terrain: "plain"
    - q: 6
      r: 2
      tile_id: 0
      terrain: "plain"
    - q: 7
      r: 2
      tile_id: 0
      terrain: "plain"
    - q: 8
      r: 2
      tile_id: 0
      terrain: "citywhite"
      name: "Hannover"
    - q: 9
      r: 2
      tile_id: 0
      terrain: "town"
    - q: 10
      r: 2
      tile_id: 0
      terrain: "plain"
    - q: 11
      r: 2
      tile_id: 0
      terrain: "citybrown"
      name: "Braunschweig"
    - q: 12
      r: 2
      tile_id: 0
      terrain: "plain"
    - q: 13
      r: 2
      tile_id: 0
      terrain: "city"
      name: "Magdeburg"
      marker: "3"
    - q: 14
      r: 2
      tile_id: 0
      terrain: "plain"
    - q: 15
      r: 2
      tile_id: 0
      terrain: "plain"
    - q: 16
      r: 2
      tile_id: 0
      terrain: "plain"
    - q: 17
      r: 2
      tile_id: 0
      terrain: "city"
      name: "Berlin"
      value: "50"
      marker: "B"
    - q: 18
      r: 2
      tile_id: 0
      terrain: "plain"
    - q: 19
      r: 2
      tile_id: 0
      terrain: "plain"
    - q: 20
      r: 2
      tile_id: 0
      terrain: "plain"
    - q: 2
      r: 3
      tile_id: 0
      terrain: "plain"
    - q: 3
      r: 3
      tile_id: 0
      terrain: "city"
      name: "Düsseldorf"
      marker: "Y"
    - q: 4
      r: 3
      tile_id: 0
      terrain: "city"
      name: "Essen/Duisburg"
      value: "50"
      marker: "XX"
    - q: 5
      r: 3
      tile_id: 0
      terrain: "plain"
    - q: 6
      r: 3
      tile_id: 0
      terrain: "city"
      name: "Dortmund"
      marker: "4"
    - q: 7
      r: 3
      tile_id: 0
      terrain: "plain"
    - q: 8
      r: 3
      tile_id: 0
      terrain: "plain"
    - q: 9
      r: 3
      tile_id: 0
      terrain: "mountain"
      value: "70"
    - q: 10
      r: 3
      tile_id: 0
      terrain: "plain"
    - q: 11
      r: 3
      tile_id: 0
      terrain: "mountain"
      value: "70"
    - q: 12
      r: 3
      tile_id: 0
      terrain: "plain"
    - q: 13
      r: 3
      tile_id: 0
      terrain: "plain"
    - q: 14
      r: 3
      tile_id: 0
      terrain: "town"
    - q: 15
      r: 3
      tile_id: 0
      terrain: "plain"
    - q: 16
      r: 3
      tile_id: 0
      terrain: "home"
      name: "Leipzig"
      marker: "S"
    - q: 17
      r: 3
      tile_id: 0
      terrain: "plain"
    - q: 18
      r: 3
      tile_id: 0
      terrain: "plain"
    - q: 19
      r: 3
      tile_id: 0
      terrain: "citywhite"
      name: "Dresden"
      marker: "Y"
    - q: 20
      r: 3
      tile_id: 0
      terrain: "plain"
    - q: 21
      r: 3
      tile_id: 0
      terrain: "plain"
    - q: 2
      r: 4
      tile_id: 0
      terrain: "plain"
    - q: 3
      r: 4
      tile_id: 0
      terrain: "city"
      name: "Köln"
      value: "50"
      marker: "Y"
    - q: 4
      r: 4
      tile_id: 0
      terrain: "plain"
    - q: 5
      r: 4
      tile_id: 0
      terrain: "town"
    - q: 6
      r: 4
      tile_id: 0
      terrain: "city"
      name: "Mainz/Wiesbaden"
      value: "50"
      marker: "XX"
    - q: 7
      r: 4
      tile_id: 0
      terrain: "plain"
    - q: 8
      r: 4
      tile_id: 0
      terrain: "city"
      name: "Frankfurt"
      value: "50"
      marker: "H"
    - q: 9
      r: 4
      tile_id: 0
      terrain: "plain"
    - q: 10
      r: 4
      tile_id: 0
      terrain: "mountain"
      value: "70"
    - q: 11
      r: 4
      tile_id: 0
      terrain: "plain"
    - q: 12
      r: 4
      tile_id: 0
      terrain: "mountain"
      value: "70"
    - q: 13
      r: 4
      tile_id: 0
      terrain: "plain"
    - q: 14
      r: 4
      tile_id: 0
      terrain: "mountain"
      value: "70"
    - q: 15
      r: 4
      tile_id: 0
      terrain: "plain"
    - q: 16
      r: 4
      tile_id: 0
      terrain: "town"
    - q: 17
      r: 4
      tile_id: 0
      terrain: "plain"
    - q: 18
      r: 4
      tile_id: 0
      terrain: "plain"
    - q: 19
      r: 4
      tile_id: 0
      terrain: "plain"
    - q: 20
      r: 4
      tile_id: 0
      terrain: "plain"
    - q: 21
      r: 4
      tile_id: 0
      terrain: "offboard"
      value: "20/30/40"
    - q: 2
      r: 5
      tile_id: 0
      terrain: "plain"
    - q: 3
      r: 5
      tile_id: 0
      terrain: "plain"
    - q: 4
      r: 5
      tile_id: 0
      terrain: "plain"
    - q: 5
      r: 5
      tile_id: 0
      terrain: "city"
      name: "Ludwigshafen/Mannheim"
      marker: "B"
    - q: 6
      r: 5
      tile_id: 0
      terrain: "plain"
    - q: 7
      r: 5
      tile_id: 0
      terrain: "plain"
    - q: 8
      r: 5
      tile_id: 0
      terrain: "mountain"
      value: "70"
    - q: 9
      r: 5
      tile_id: 0
      terrain: "plain"
    - q: 10
      r: 5
      tile_id: 0
      terrain: "town"
    - q: 11
      r: 5
      tile_id: 0
      terrain: "plain"
    - q: 12
      r: 5
      tile_id: 0
      terrain: "plain"
    - q: 13
      r: 5
      tile_id: 0
      terrain: "city"
      name: "Fürth/Nürnberg"
      value: "50"
      marker: "XX"
    - q: 14
      r: 5
      tile_id: 0
      terrain: "plain"
    - q: 15
      r: 5
      tile_id: 0
      terrain: "mountain"
      value: "70"
    - q: 16
      r: 5
      tile_id: 0
      terrain: "plain"
    - q: 17
      r: 5
      tile_id: 0
      terrain: "plain"
    - q: 18
      r: 5
      tile_id: 0
      terrain: "plain"
    - q: 2
      r: 6
      tile_id: 0
      terrain: "offboard"
      value: "50"
    - q: 3
      r: 6
      tile_id: 0
      terrain: "plain"
    - q: 4
      r: 6
      tile_id: 0
      terrain: "town"
    - q: 5
      r: 6
      tile_id: 0
      terrain: "plain"
    - q: 6
      r: 6
      tile_id: 0
      terrain: "plain"
    - q: 7
      r: 6
      tile_id: 0
      terrain: "home"
      name: "Stuttgart"
      marker: "W"
    - q: 8
      r: 6
      tile_id: 0
      terrain: "mountain"
      value: "70"
    - q: 9
      r: 6
      tile_id: 0
      terrain: "plain"
    - q: 10
      r: 6
      tile_id: 0
      terrain: "citywhite"
      name: "Augsburg"
    - q: 11
      r: 6
      tile_id: 0
      terrain: "plain"
    - q: 12
      r: 6
      tile_id: 0
      terrain: "mountain"
      value: "70"
    - q: 13
      r: 6
      tile_id: 0
      terrain: "town"
    - q: 14
      r: 6
      tile_id: 0
      terrain: "plain"
    - q: 15
      r: 6
      tile_id: 0
      terrain: "plain"
    - q: 16
      r: 6
      tile_id: 0
      terrain: "plain"
    - q: 17
      r: 6
      tile_id: 0
      terrain: "plain"
    - q: 3
      r: 7
      tile_id: 0
      terrain: "citywhite"
      name: "Freiburg"
    - q: 4
      r: 7
      tile_id: 0
      terrain: "plain"
    - q: 5
      r: 7
      tile_id: 0
      terrain: "plain"
    - q: 6
      r: 7
      tile_id: 0
      terrain: "mountain"
      value: "70"
    - q: 7
      r: 7
      tile_id: 0
      terrain: "town"
    - q: 8
      r: 7
      tile_id: 0
      terrain: "plain"
    - q: 9
      r: 7
      tile_id: 0
      terrain: "plain"
    - q: 10
      r: 7
      tile_id: 0
      terrain: "plain"
    - q: 11
      r: 7
      tile_id: 0
      terrain: "plain"
    - q: 12
      r: 7
      tile_id: 0
      terrain: "plain"
    - q: 13
      r: 7
      tile_id: 0
      terrain: "plain"
    - q: 14
      r: 7
      tile_id: 0
      terrain: "home"
      name: "München"
      marker: "Y"
    - q: 15
      r: 7
      tile_id: 0
      terrain: "plain"
```
